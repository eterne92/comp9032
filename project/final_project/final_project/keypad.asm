/*
 * KEYPAD.ASM
 *
 *  CREATED: 2017/10/3
 *  AUTHOR: SHAOHUI Z5155945
 */ 
;----------------------------------
;FUNCTIONS RELATED TO KEYPAD
;GET_KEY
;KEY_ASCII
;----------------------------------
;KEYPAD SHOULD BE CONNECTED AS BELOW
;KEYPAD -> PORTL
;COLUMS -> 4:7
;ROWS -> 0:3
;PORT DIRECTIONS SHOULD BE SET ON RESET
;----------------------------------
.EQU ROWMASK = 0X0F
.EQU COLMASK = 0B11101111	;START FROM C0

;FUNCTION TO GET KEYVALUE FROM KEYPAD, RETURN ROW:COL ON R24:R25
GET_KEY:
	PUSH R16				;R16 AS RMASK
	PUSH R17				;R17 AS ROW
	PUSH R18				;R18 AS COL
	PUSH R19				;R19 AS TEMP1
	PUSH R20				;R20 AS TEMP2
	PUSH R21				;R21 AS CMASK
	SET_CMASK:
		LDI R21, COLMASK
		STORE KEY_PORT, R21	;SET COLMASK TO 0X11101111
		CLR R18				;SET COL TO 0
	CLOOP:
		LDI R16, 0X01		;START FROM ROW 0
		CLR R17				;SET ROW TO 0
	RLOOP:
		LOAD R19, PINL		;GET VALUE FROM KEYPAD
		MOV R20, R19
		ANDI R20, ROWMASK	;CLR COL INPUT
		AND R20, R16
		BRNE NEXT_ROW
		RJMP DEBOUNCING_LOOP
	NEXT_ROW:
		LSL R16				;LEFTSHIFT RMASK
		INC R17				;ROW = ROW + 1
		CPI R17, 4			;IF ROW == 4
		BREQ NEXT_COL		;GOTO NEXT COL
		RJMP RLOOP			;ELSE GOTO NEXT ROW
	NEXT_COL:
		LSL R21				;LEFTSHIFT CMASK
		INC R18				;COL = COL + 1
		CPI R18, 4			;IF COL == 4
		BREQ SET_CMASK		;STARTOVER AGAIN
		INC R21
		STORE KEY_PORT, R21		;SET CMASK
		RJMP CLOOP			;GOTO NEXT COL

	DEBOUNCING_LOOP:		;SOLVE DEBOUNCING
		LOAD R19, PINL
		ANDI R19, ROWMASK
		CPI R19, 0X0F
		BRNE DEBOUNCING_LOOP
	MOV R24, R17			;R24 AS ROW
	MOV R25, R18			;R25 AS COL

	POP R21
	POP R20
	POP R19
	POP R18
	POP R17
	POP R16
	RET

;GET KEY_ASCII VALUE FROM INPUT AS R24->ROW, R25->COL, RETURN ASCII VALUE AS R23
KEY_ASCII:
	PUSH R24				;R24 AS ROW
	PUSH R25				;R25 AS COL
	PUSH R16				;R16 AS TEMP
	PUSH R0
	PUSH R1					;MUL WILL BE USED

	RCALL GET_KEY
	CPI R25, 3				;IF COL == 3
	BREQ ASCII_LETTER
	CPI R24, 3				;IF ROW == 3
	BREQ ASCII_SYMBOL
	LDI R16, 3				;TEMP = 3 * ROW + COL
	MUL R24, R16			;
	MOV R16, R0
	ADD R16, R25 
	SUBI R16, -'1'			;GET ASCII VALUE
	MOV R23, R16
	RJMP RETURN_KEY_ASCII

	ASCII_LETTER:
		LDI R16, 'A'			;TEMP = 'A'
		ADD R16, R24			;TEMP += ROW
		MOV R23, R16
		RJMP RETURN_KEY_ASCII

	ASCII_SYMBOL:
		CPI R25, 0				;'*'
		BREQ ASCII_STAR
		CPI R25, 1				;'0'
		BREQ ASCII_ZERO
		LDI R23, '#'			;'#'
		RJMP RETURN_KEY_ASCII

	ASCII_STAR:
		LDI R23, '*'
		RJMP RETURN_KEY_ASCII

	ASCII_ZERO:
		LDI R23, '0'
		RJMP RETURN_KEY_ASCII

RETURN_KEY_ASCII:
	POP R1
	POP R0
	POP R16
	POP R25
	POP R24
	RET